## sdkconfig.defaults
```kconfig
#
# Espressif IoT Development Framework Configuration
#

#
# ESP32 qcloud mqtt demo Configuration
#
CONFIG_QCLOUD_WiFi_SSID="HUAWEI001"
CONFIG_QCLOUD_WiFi_PASSWORD="espressif"
CONFIG_QCLOUD_PROUDCT_ID="PA543HC32B"
CONFIG_QCLOUD_DEVICE_NAME="test_dev_01"
CONFIG_QCLOUD_CERT_FILENAME="test_dev_01_cert.crt"
CONFIG_QCLOUD_KEY_FILENAME="test_dev_01_private.key"

#
# Partition Table
#
CONFIG_PARTITION_TABLE_SINGLE_APP=
CONFIG_PARTITION_TABLE_TWO_OTA=
CONFIG_PARTITION_TABLE_CUSTOM=y
CONFIG_PARTITION_TABLE_CUSTOM_FILENAME="partitions_qcloud_demo.csv"
CONFIG_PARTITION_TABLE_CUSTOM_APP_BIN_OFFSET=0x10000
CONFIG_PARTITION_TABLE_FILENAME="partitions_qcloud_demo.csv"
CONFIG_APP_OFFSET=0x10000

#
# FAT Filesystem support
#
CONFIG_FATFS_CODEPAGE_DYNAMIC=
CONFIG_FATFS_CODEPAGE_437=y
CONFIG_FATFS_CODEPAGE_720=
CONFIG_FATFS_CODEPAGE_737=
CONFIG_FATFS_CODEPAGE_771=
CONFIG_FATFS_CODEPAGE_775=
CONFIG_FATFS_CODEPAGE_850=
CONFIG_FATFS_CODEPAGE_852=
CONFIG_FATFS_CODEPAGE_855=
CONFIG_FATFS_CODEPAGE_857=
CONFIG_FATFS_CODEPAGE_860=
CONFIG_FATFS_CODEPAGE_861=
CONFIG_FATFS_CODEPAGE_862=
CONFIG_FATFS_CODEPAGE_863=
CONFIG_FATFS_CODEPAGE_864=
CONFIG_FATFS_CODEPAGE_865=
CONFIG_FATFS_CODEPAGE_866=
CONFIG_FATFS_CODEPAGE_869=
CONFIG_FATFS_CODEPAGE_932=
CONFIG_FATFS_CODEPAGE_936=
CONFIG_FATFS_CODEPAGE_949=
CONFIG_FATFS_CODEPAGE_950=
CONFIG_FATFS_CODEPAGE=437
CONFIG_FATFS_LFN_NONE=
CONFIG_FATFS_LFN_HEAP=y
CONFIG_FATFS_LFN_STACK=
CONFIG_FATFS_MAX_LFN=255
CONFIG_FATFS_FS_LOCK=10
CONFIG_FATFS_TIMEOUT_MS=10000
CONFIG_FATFS_PER_FILE_CACHE=y

#
# Wear Levelling
#
CONFIG_WL_SECTOR_SIZE_512=y
CONFIG_WL_SECTOR_SIZE_4096=
CONFIG_WL_SECTOR_SIZE=512
CONFIG_WL_SECTOR_MODE_PERF=
CONFIG_WL_SECTOR_MODE_SAFE=y
CONFIG_WL_SECTOR_MODE=1
```
